## board/radxa/e52c-rk3588s/Kconfig
```kconfig
if TARGET_RADXA_E52C_RK3588S

config SYS_BOARD
	default "e52c-rk3588s"

config SYS_VENDOR
	default "radxa"

config SYS_CONFIG_NAME
	default "e52c-rk3588s"

endif
```

## board/radxa/rock-5t-rk3588/Kconfig
```kconfig
if TARGET_ROCK_5T_RK3588

config SYS_BOARD
	default "rock-5t-rk3588"

config SYS_VENDOR
	default "radxa"

config SYS_CONFIG_NAME
	default "rock-5t-rk3588"

endif
```

// SPDX-License-Identifier: (GPL-2.0+ OR MIT)
/*
 * Copyright (c) 2024 Radxa Computer (Shenzhen) Co., Ltd.
 */

#include "rk3588s-u-boot.dtsi"

&fspim0_pins {
	bootph-pre-ram;
	bootph-some-ram;
};

&sdhci {
	status = "disabled";
};

&sfc {
	status = "okay";

	flash@0 {
		bootph-pre-ram;
		bootph-some-ram;
	};
};
